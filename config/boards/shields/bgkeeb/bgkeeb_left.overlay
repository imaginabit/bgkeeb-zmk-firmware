#include "bgkeeb.dtsi" // Notice that the main dtsi files are included in the overlay.

&kscan0 {
    // #define MATRIX_ROW_PINS { F6, D7, B3, E6 }     == { 19, 6, 14, 7 }
    // #define MATRIX_COL_PINS { F4, D4, F5, B1, B2 } == { 21, 4, 20, 15, 16 }
    // INVERTED 180°: nice!nano v2 mounted reversed.
    // Original: col0=pad20→D21→21, col1=pad7→D4→4, col2=pad19→D20→20, col3=pad16→D15→15, col4=pad14→D16→16
    // Inverted: col0=pad20←module_pad5→D2→2, col1=pad7←module_pad18→D19→19,
    //          col2=pad19←module_pad6→D3→3, col3=pad16←module_pad9→D6→6, col4=pad14←module_pad11→D8→8
    col-gpios
        = <&pro_micro 2  (GPIO_ACTIVE_HIGH | GPIO_PULL_DOWN)> // col0 (inverted)
        , <&pro_micro 19 (GPIO_ACTIVE_HIGH | GPIO_PULL_DOWN)> // col1 (inverted)
        , <&pro_micro 3  (GPIO_ACTIVE_HIGH | GPIO_PULL_DOWN)> // col2 (inverted)
        , <&pro_micro 6  (GPIO_ACTIVE_HIGH | GPIO_PULL_DOWN)> // col3 (inverted)
        , <&pro_micro 8  (GPIO_ACTIVE_HIGH | GPIO_PULL_DOWN)> // col4 (inverted)
        ;
};